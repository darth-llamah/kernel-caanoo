## arch/arm/mach-pollux/Kconfig
```kconfig
if ARCH_POLLUX

menu "POLLUX Implementations"

config MACH_AESOP_POLLUX
	bool "AESOP Pollux Reference Kit"
	default y
	select ISA
	help
	  Say Y here if you are using the AESOP pollux(of Magiceyes) implementation

	  Product page: <http://www.aesop-embedded.org>.

config ARCH_ADD_GPH_N35
	bool "Game park holdings POLLUX(LF1000) hand game machine"

endmenu

choice
        prompt "Pollux Shadow(bootmode) setting"
        depends on ARCH_POLLUX
        help
           Pollux boot mode selection(Memory map changed)

config POLLUX_SHADOW_ONE
	bool "shadow=1:NAND boot"
	help
	  Shadow is 1(nand boot mode), see Pollux Datasheet

config POLLUX_SHADOW_ZERO
	bool "shadow=0:NOR boot"
	help
	  Shadow is 0(NOR boot mode), see Pollux Datasheet
	  
endchoice

config POLLUX_KERNEL_BOOT_MESSAGE_ENABLE
    bool "Kernel boot message enable"
    default y

config POLLUX_FAST_BOOT_ENABLE
    bool "Apply Fast Boot enable"
    default n
    help
        MTD driver for this mode is selected, the bad block is
        processed in the CRAMFS area.
        
config POLLUX_LOWLEVEL_UART_PORT
	int "Pollux UART to use for low-level messages"
	default 0
	help
	  Choice of which UART port to use for the low-level messages,
	  such as the `Uncompressing...` at start time. The value of
	  this configuration should be between zero and two. The port
	  must have been initialised by the boot-loader before use.

	  Note, this does not affect the port used by the debug messages,
	  which is a separate configuration.

endif
```

## drivers/haptic/Kconfig
```kconfig
#
# HAPTIC driver configuration
#
menuconfig HAPTIC
	bool "HAPTIC support"
	help
	  Say Y to enalbe haptic support. It enables the haptic and controlled
	  from both userspace and kernel

if HAPTIC

config SIMPLE_ISA1200_DRIVER
	tristate "ISA1200 - Simple Haptic Driver"
	depends on I2C
	help
	  This option enables the simple haptic driver that uses only devfs and it controled by ioctl() function.

endif
```

## drivers/mmc/card/Kconfig
```kconfig
#
# MMC/SD card drivers
#

comment "MMC/SD Card Drivers"
	depends on MMC

config MMC_BLOCK
	tristate "MMC block device driver"
	depends on MMC && BLOCK
	default y
	help
	  Say Y here to enable the MMC block device driver support.
	  This provides a block device driver, which you can use to
	  mount the filesystem. Almost everyone wishing MMC support
	  should say Y or M here.

config MMC_ND_CHAR
	tristate "Direct char device access to mmc nd_card devices"
	depends on MMC
	default y
	help
	  This provides a character device for each mmc_nd_device present in
	  the system, allowing the user to read and write directly to the
	  memory chips.
```
